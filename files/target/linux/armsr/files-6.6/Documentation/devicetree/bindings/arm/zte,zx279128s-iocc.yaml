## files/target/linux/armsr/files-6.6/Documentation/devicetree/bindings/arm/zte,zx279128s-iocc.yaml
```yaml
# SPDX-License-Identifier: (GPL-2.0-only OR BSD-2-Clause)
%YAML 1.2
---
$id: http://devicetree.org/schemas/arm/zte,zx279128s-iocc.yaml#
$schema: http://devicetree.org/meta-schemas/core.yaml#

title: ZTE ZX279128S I/O coherency configuration

maintainers:
  - Adriel Santos <adriel@adriel.eu>

description: |
  System coherency registers initialized by the ZX279128S machine code before
  PCI host devices are populated. PCI hosts using this configuration declare
  dma-coherent. The configuration uses identity DMA addresses.

properties:
  compatible:
    const: zte,zx279128s-iocc
  reg:
    maxItems: 1

required:
  - compatible
  - reg

additionalProperties: false

examples:
  - |
    coherency@a20000 {
        compatible = "zte,zx279128s-iocc";
        reg = <0x00a20000 0x1000>;
    };
```

## files/target/linux/armsr/files-6.6/Documentation/devicetree/bindings/clock/zte,zx279128s-crm.yaml
```yaml
# SPDX-License-Identifier: (GPL-2.0-only OR BSD-2-Clause)
%YAML 1.2
---
$id: http://devicetree.org/schemas/clock/zte,zx279128s-crm.yaml#
$schema: http://devicetree.org/meta-schemas/core.yaml#

title: ZTE ZX279128S clock and reset manager (CRM)

maintainers:
  - Adriel Santos <adriel@adriel.eu>

description: |
  The ZX279128S keeps its clock and reset controls in several clock/reset
  manager blocks: TOPCRM (0x94000000), CRM1 (0x94100000), CRM2
  (0x94200000), LSP0CRPM (0x94400000) and LSP1CRPM (0x9a100000). This node
  covers the four blocks whose fields are modelled today; each reg entry is
  one whole 4 KiB block. Every field is an entry of the stock kernel's own
  clock tables (zx279127_{top,lsp0,lsp1}_clocks_init), restricted to the
  clocks this SoC's consumers take.

  Clocks, one-cell specifier, indices in
  include/dt-bindings/clock/zte,zx279128s-crm.h:

    - ZX_CRM_SPI_WCLK (0): SPI flash controller working clock. Gate in
      LSP0CRPM + 0x18 bit 1, after a divider in LSP0CRPM + 0x18 bits
      [16:11] (divisor = field + 1, not a power of two), fed by
      ZX_CRM_LSP0_WCLK.
    - ZX_CRM_SPI_PCLK (1): SPI flash controller peripheral clock. Gate in
      LSP0CRPM + 0x18 bit 0, fed by ZX_CRM_LSP0_PCLK.
    - ZX_CRM_LSP0_WCLK (2): shared LSP0 working-clock parent. Gate in
      TOPCRM + 0x14 bit 13, fed by the first "clocks" entry.
    - ZX_CRM_LSP0_PCLK (3): shared LSP0 peripheral-clock parent. Gate in
      TOPCRM + 0x14 bit 11, fed by the second "clocks" entry.
    - ZX_CRM_LSP1_WCLK (4): shared LSP1 100 MHz working-clock parent. Gate
      in TOPCRM + 0x14 bit 7, fed by the first "clocks" entry.
    - ZX_CRM_LSP1_PCLK (5): shared LSP1 peripheral-clock parent. Gate in
      TOPCRM + 0x14 bit 5, fed by the second "clocks" entry.
    - ZX_CRM_MDIO_WCLK (6): MDIO controller working clock. Gate in
      LSP1CRPM + 0x04 bit 1, after a divider in LSP1CRPM + 0x04 bits [17:11]
      (divisor = field + 1), fed by ZX_CRM_LSP1_WCLK. The stock tree's
      "<&lsp1crpm 1>".
    - ZX_CRM_MDIO_PCLK (7): MDIO controller peripheral clock. Gate in
      LSP1CRPM + 0x04 bit 0, fed by ZX_CRM_LSP1_PCLK.
    - ZX_CRM_GPIO_PCLK (8): GPIO controller peripheral clock. Gate in
      LSP0CRPM + 0x1c bit 0, fed by ZX_CRM_LSP0_PCLK.

  The two "clocks" inputs serve both LSP blocks: in the stock tables the
  LSP0 and LSP1 100 MHz gates share one parent (clk_100m) and the two APB
  gates share another (matrix_pclk).

  Every gate above is on when the boot firmware hands over, and an access
  to an unclocked block on this SoC hangs it, so the provider never gates
  them. PLLs and source selection are left as the firmware set them; the
  two "clocks" inputs describe the rates the firmware leaves behind.

  Resets, one-cell specifier, indices in
  include/dt-bindings/reset/zte,zx279128s-crm.h. All are in CRM1 + 0x74
  and are active low (a clear bit holds the block in reset):

    - ZX_CRM_RST_PCIE0 (0): PCIe controller 0, bit 0.
    - ZX_CRM_RST_PCIE1 (1): PCIe controller 1, bit 3.

  The other bits of CRM1 + 0x74 are not identified.

  The blocks are shared with other nodes: the system reset trigger at
  TOPCRM + 0x44 has its own node (zte,zx279128s-reboot), because the
  generic syscon-reboot was tried on this board and hung it.

  TODO: not modelled yet:
    - CRM2. The stock clock tables have no CRM2 entry at all; the only CRM2
      field this port touches is +0x0c, a pin-mux word the PCIe sequence
      edits.
    - The PCIe clock enables (TOPCRM + 0x08 bits 13-15 and 25-27, which are
      not in the stock clock tables either) and the PCIe configuration
      fields (TOPCRM + 0x24, CRM1 + 0x70). The PCIe nodes keep their own
      crm0..crm2 reg entries for them.
    - The other LSP0/LSP1 clocks (UART, timers, I2C, SSP, TDM, ...). Their
      consumers here take fixed clocks or have no node.

properties:
  compatible:
    const: zte,zx279128s-crm

  reg:
    items:
      - description: TOPCRM block
      - description: CRM1 block
      - description: LSP0CRPM block
      - description: LSP1CRPM block

  reg-names:
    items:
      - const: topcrm
      - const: crm1
      - const: lsp0crpm
      - const: lsp1crpm

  clocks:
    items:
      - description:
          LSP0 working-clock reference, 100 MHz as set up by the boot
          firmware (pll_lsp / 10)
      - description: Matrix peripheral-clock reference (APB, 125 MHz)

  clock-names:
    items:
      - const: lsp0-wclk
      - const: lsp0-pclk

  '#clock-cells':
    const: 1

  '#reset-cells':
    const: 1

required:
  - compatible
  - reg
  - reg-names
  - clocks
  - clock-names
  - '#clock-cells'
  - '#reset-cells'

additionalProperties: false

examples:
  - |
    clock-controller@94000000 {
        compatible = "zte,zx279128s-crm";
        reg = <0x94000000 0x1000>,
              <0x94100000 0x1000>,
              <0x94400000 0x1000>,
              <0x9a100000 0x1000>;
        reg-names = "topcrm", "crm1", "lsp0crpm", "lsp1crpm";
        clocks = <&lsp0_ref>, <&apb_pclk>;
        clock-names = "lsp0-wclk", "lsp0-pclk";
        #clock-cells = <1>;
        #reset-cells = <1>;
    };
...
```

## files/target/linux/armsr/files-6.6/Documentation/devicetree/bindings/power/reset/zte,zx279128s-reboot.yaml
```yaml
# SPDX-License-Identifier: (GPL-2.0-only OR BSD-2-Clause)
%YAML 1.2
---
$id: http://devicetree.org/schemas/power/reset/zte,zx279128s-reboot.yaml#
$schema: http://devicetree.org/meta-schemas/core.yaml#

title: ZTE ZX279128S system reset trigger

maintainers:
  - Adriel Santos <adriel@adriel.eu>

description: |
  A dedicated word at TOPCRM offset 0x44 requests a system reset when
  written with 1. The driver must use an unconditional ordered write;
  the register is not a generic read/modify/write control word.

properties:
  compatible:
    const: zte,zx279128s-reboot

  reg:
    maxItems: 1

required:
  - compatible
  - reg

additionalProperties: false

examples:
  - |
    reset-controller@94000044 {
        compatible = "zte,zx279128s-reboot";
        reg = <0x94000044 0x4>;
    };
```

## files/target/linux/armsr/files-6.6/Documentation/devicetree/bindings/spi/zte,zx279128s-spifc.yaml
```yaml
# SPDX-License-Identifier: (GPL-2.0-only OR BSD-2-Clause)
%YAML 1.2
---
$id: http://devicetree.org/schemas/spi/zte,zx279128s-spifc.yaml#
$schema: http://devicetree.org/meta-schemas/core.yaml#

title: ZTE ZX279128S SPI memory controller

maintainers:
  - Adriel Santos <adriel@adriel.eu>

allOf:
  - $ref: spi-controller.yaml#

properties:
  compatible:
    const: zte,zx279128s-spifc
  reg:
    maxItems: 1
  interrupts:
    maxItems: 1
  clocks:
    items:
      - description: Peripheral register clock
      - description: SPI working clock
  clock-names:
    items:
      - const: pclk
      - const: wclk
  '#address-cells':
    const: 1
  '#size-cells':
    const: 0

required:
  - compatible
  - reg
  - clocks
  - clock-names
  - '#address-cells'
  - '#size-cells'

unevaluatedProperties: false
```

## files/target/linux/armsr/files-6.6/drivers/net/ethernet/zte/Kconfig
```kconfig
# SPDX-License-Identifier: GPL-2.0
config NET_VENDOR_ZTE
	bool "ZTE/Sanechips devices"
	default y
	depends on OF
	help
	  If you have a network (Ethernet) device belonging to this class,
	  say Y.

if NET_VENDOR_ZTE

config ZX279128_ETH
	tristate "ZTE ZX279128S Ethernet"
	depends on OF
	select PHYLIB
	help
	  Ethernet driver for the ZTE/Sanechips ZX279128S SoC (ZXHN H199A).
	  Uses the SoC's hardware buffer manager and traffic manager rather
	  than a conventional descriptor-ring DMA engine.

config ZX279128_PCIE_PROBE_TEST
	bool "ZX279128S PCIe bring-up validation"
	depends on OF
	default y
	help
	  Runs the reverse-engineered PCIe PHY bring-up sequence once at
	  late_initcall, printing before and after each step so that a hang
	  identifies the offending step exactly.

	  Opt-in at runtime: it does nothing unless "zx_pcie_test" is on the
	  kernel command line. It is a separate symbol from ZX279128_ETH
	  because it is bring-up scaffolding rather than part of the driver,
	  and because it uses __setup(), which only works when built in - so
	  it must stay boolean even when the Ethernet driver is built as a
	  module.

	  Say N for a production image.

config ZX279128_ETH_DEBUG
	bool "ZX279128S Ethernet bring-up debug interfaces"
	depends on ZX279128_ETH
	default n
	help
	  Exposes bring-up instrumentation for this reverse-engineered driver:
	  per-protocol receive counters, a descriptor identity dump, and the
	  /proc entries zx_eth_regs (register dump), zx_eth_packets,
	  zx_eth_poke and zx_eth_reinit (manual diagnostic datapath reset).
	  Experimental module parameters are also available only with this option.

	  These were decisive during bring-up - the register dump located the
	  SoC's packet-parser block, and the poke interface reduced each
	  candidate register from a six-minute build-flash-boot cycle to
	  seconds.

	  SECURITY: zx_eth_poke gives root arbitrary physical-address
	  read/modify/write. On a router that turns any root compromise into
	  permanent hardware manipulation, and a mistyped address can wedge the
	  SoC or corrupt DDR. It has no place in a production image.

	  Say N unless you are debugging this driver.

config ZX279128_PP_TABLES
	bool "ZX279128S packet-processor table access (experimental)"
	depends on ZX279128_ETH
	default n
	help
	  Groundwork for hardware flow offload; offloads nothing itself.
	  Allocates the packet processor's PM (1 MiB) and ACL (4 MiB) DRAM
	  tables, programs their base registers, and implements the CLA and
	  PM indirect table ports. Read-only inspection is available
	  under /sys/kernel/debug/zx279128-pp; separately gated FLOW_TEST
	  and OFFLOAD options add experimental table mutation paths.

	  The protocol is recovered from the vendor modules. Bounded register/table
	  experiments have been run, but a working production per-flow
	  offload path has not been demonstrated. Follow the
	  qualification steps in docs/PP-OFFLOAD.md before enabling this in
	  any image.

	  Say N.

config ZX279128_PP_FLOW_TEST
	bool "ZX279128S packet-processor single-flow install test (experimental)"
	depends on ZX279128_PP_TABLES
	default n
	help
	  Adds a strictly gated, test-only write path on top of the packet
	  processor table access: a root-only, write-only debugfs control file
	  /sys/kernel/debug/zx279128-pp/flow that installs EXACTLY ONE
	  explicitly-specified IPv4 forwarding flow into the CLA and PM DRAM
	  tables and reads its CLA hit bit. It offloads no real traffic and has
	  no conntrack integration.

	  It writes only tables and fields that docs/PP-FLOW.md marks proven or
	  likely and refuses (-EOPNOTSUPP) anything resting on an unknown
	  (header rewrite, IPv6, DNAT, VLAN). A module parameter
	  flow_test_enable must be set to 1 before any write is accepted.

	  This writes into tables the live datapath engine walks. It is for
	  bounded hardware bring-up only; follow docs/PP-OFFLOAD.md. There is
	  no reason to enable it in any image you are not qualifying by hand.

	  Say N.

config ZX279128_PP_OFFLOAD
	bool "ZX279128S packet-processor hardware flow offload (experimental)"
	depends on ZX279128_PP_TABLES && NF_FLOW_TABLE
	default n
	help
	  Experimental TC_SETUP_FT helpers intended to translate
	  nf_flow_table (netfilter flow-table) entries into CLA
	  exact-match and PM forwarding entries through the standard
	  ndo_setup_tc / TC_SETUP_FT path. The current Ethernet driver does not
	  install this hook; integration remains an unapplied patch under
	  docs/offload/. The helper accepts only IPv4 TCP/UDP flows
	  whose two ends are both hardware switch ports; WiFi, tunnels, IPv6,
	  VLAN, PPPoE, fragments, NAT and multi-redirect flows stay in the
	  software datapath.

	  The "depends on NF_FLOW_TABLE" is load-bearing, not cosmetic.
	  The release selects ZX279128_ETH built-in and nf_flow_table as a module;
	  without this dependency - AND nf_flow_table being built
	  in wherever this is enabled - the kernel link fails at the very end
	  of the build (docs/upstream/SERIES.md). The depends also keeps this
	  symbol unselectable until the table access it rests on exists.

	  Not hardware-qualified. Follow docs/PP-OFFLOAD.md. Say N.

endif # NET_VENDOR_ZTE
```
